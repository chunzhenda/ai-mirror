## Firmware/esp32_ai_mirror/main/Kconfig.projbuild
```kconfig
menu "AI Mirror Configuration"

    choice AI_MIRROR_AUDIO_MODE
        prompt "AI Mirror audio mode"
        default AI_MIRROR_AUDIO_MODE_ECHO
        help
            Select the audio work mode used by the AI Mirror firmware.

        config AI_MIRROR_AUDIO_MODE_MUSIC
            bool "music playback"
        config AI_MIRROR_AUDIO_MODE_ECHO
            depends on !AI_MIRROR_BSP
            bool "microphone echo test"
    endchoice

    choice AI_MIRROR_SELECT_MIC_GAIN
        prompt "Set MIC gain"
        depends on AI_MIRROR_AUDIO_MODE_ECHO
        default MIC_GAIN_18DB
        help
            Select ES8311 microphone gain for echo/test mode.

        config MIC_GAIN_0DB
            bool "0dB"
        config MIC_GAIN_6DB
            bool "6dB"
        config MIC_GAIN_12DB
            bool "12dB"
        config MIC_GAIN_18DB
            bool "18dB"
        config MIC_GAIN_24DB
            bool "24dB"
        config MIC_GAIN_30DB
            bool "30dB"
        config MIC_GAIN_36DB
            bool "36dB"
        config MIC_GAIN_42DB
            bool "42dB"
    endchoice

    config AI_MIRROR_MIC_GAIN
        int
        default 0 if MIC_GAIN_0DB
        default 1 if MIC_GAIN_6DB
        default 2 if MIC_GAIN_12DB
        default 3 if MIC_GAIN_18DB
        default 4 if MIC_GAIN_24DB
        default 5 if MIC_GAIN_30DB
        default 6 if MIC_GAIN_36DB
        default 7 if MIC_GAIN_42DB

    config AI_MIRROR_VOICE_VOLUME
        int "Voice volume"
        range 0 100
        default 70
        help
            Set ES8311 output volume.

    config AI_MIRROR_BSP
        bool "Enable Board Support Package (BSP) support"
        default n
        help
            Use BSP to setup board hardware settings.

    config AI_MIRROR_GATEWAY_ENABLE
        bool "Enable local gateway communication"
        default n
        depends on AI_MIRROR_AUDIO_MODE_ECHO
        help
            Upload completed microphone recordings to a local HTTP gateway and
            poll the gateway for device commands.

    config AI_MIRROR_GATEWAY_URL
        string "Local gateway base URL"
        default "http://192.168.10.100:8000"
        depends on AI_MIRROR_GATEWAY_ENABLE

    config AI_MIRROR_GATEWAY_DEVICE_ID
        string "Gateway device ID"
        default "ai-mirror-001"
        depends on AI_MIRROR_GATEWAY_ENABLE

    config AI_MIRROR_GATEWAY_TOKEN
        string "Gateway device token"
        default "ai-mirror-dev"
        depends on AI_MIRROR_GATEWAY_ENABLE

    config AI_MIRROR_GATEWAY_POLL_MS
        int "Command long-poll interval (ms)"
        range 250 10000
        default 1000
        depends on AI_MIRROR_GATEWAY_ENABLE

    config AI_MIRROR_GATEWAY_HTTP_TIMEOUT_MS
        int "Gateway HTTP timeout (ms)"
        range 1000 60000
        default 60000
        depends on AI_MIRROR_GATEWAY_ENABLE
endmenu
```

## Firmware/esp32_ai_mirror/sdkconfig.defaults
```kconfig
CONFIG_BT_ENABLED=y
CONFIG_BTDM_CTRL_MODE_BLE_ONLY=y
CONFIG_BTDM_CTRL_MODE_BR_EDR_ONLY=n
CONFIG_BTDM_CTRL_MODE_BTDM=n
CONFIG_BT_NIMBLE_ENABLED=y
CONFIG_LV_USE_QRCODE=y
CONFIG_BT_NIMBLE_MEM_ALLOC_MODE_INTERNAL=n
CONFIG_BT_NIMBLE_MEM_ALLOC_MODE_EXTERNAL=y
CONFIG_NIMBLE_MEM_ALLOC_MODE_INTERNAL=n
CONFIG_NIMBLE_MEM_ALLOC_MODE_EXTERNAL=y
CONFIG_BT_NIMBLE_ROLE_CENTRAL=n
CONFIG_NIMBLE_ROLE_CENTRAL=n
CONFIG_BT_NIMBLE_ROLE_OBSERVER=n
CONFIG_NIMBLE_ROLE_OBSERVER=n
CONFIG_BT_NIMBLE_MAX_CONNECTIONS=1
CONFIG_NIMBLE_MAX_CONNECTIONS=1
CONFIG_BT_NIMBLE_MAX_BONDS=1
CONFIG_NIMBLE_MAX_BONDS=1
CONFIG_BT_NIMBLE_MAX_CCCDS=4
CONFIG_NIMBLE_MAX_CCCDS=4
CONFIG_BT_CTRL_BLE_MAX_ACT=3
```
